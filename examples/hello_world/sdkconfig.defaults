## main/Kconfig.projbuild
```kconfig
menu "alc-gw-p4 Relay Configuration"

    config RELAY_RTSP_URL
        string "C212 RTSP URL (stream2, 転送用、認証情報は含めない)"
        default "rtsp://192.168.1.50:554/stream2"
        help
            C212 の転送用 RTSP URL (360p サブストリーム)。ローカル表示は
            行わないため stream1 とは別。docs/whip-convention.md 参照。
            認証情報は埋め込まず RELAY_RTSP_USERNAME/PASSWORD を使う
            (esp_media_protocols 時代の user:pass@ 埋め込みは自前RTSP
            クライアント (rtsp_client) への置き換えで廃止、alc-gw-p4#1)。

    config RELAY_RTSP_USERNAME
        string "C212 RTSP username (RTSP Digest認証)"
        default ""
        help
            RTSP Digest 認証のユーザー名。空なら認証なしとして接続する。

    config RELAY_RTSP_PASSWORD
        string "C212 RTSP password (RTSP Digest認証)"
        default ""
        help
            RTSP Digest 認証のパスワード。

    config RELAY_SIGNALING_HOST
        string "Camera signaling room host (wss://<host>/cam-room/<拠点ID>)"
        default "alc-signaling.ippoan.org"
        help
            ippoan/alc-app cf-alc-signaling の CameraSignalingRoom
            (ippoan/alc-app#129) のホスト名 (custom domain、旧
            *.workers.dev から移行)。全デバイス共通のOTAバイナリに焼く値
            なので、拠点ごとに変わる site_id はここに含めない —
            device credential の cam-relay-token mint 応答から得た site_id
            を relay.c が実行時に付与して "/cam-room/<site_id>" を組み立てる
            (RELAY_SIGNALING_ROOM_OVERRIDE 参照)。空なら relay_task 自体を
            起動しない (relay.c 参照) — 以前は full URL をこの設定に直接
            書く方式で、ダミーの example.workers.dev を既定にしていたため
            未設定のまま起動すると DNS 解決失敗の再接続ループが priority 5
            で回り続け、priority 2 の console REPL タスクが実質的に応答
            不能になる事故があった (同じ理由で空文字を安全な既定にしている)。

    config RELAY_SIGNALING_ROOM_OVERRIDE
        string "Camera signaling room (site_id) — device credential 未設定時のみ使う開発用の固定値"
        default ""
        help
            device credential (role=device-gateway) が設定済みなら
            cam-relay-token mint 応答の site_id を常に優先する (本番経路)。
            credential 未設定、または mint に失敗した場合のみ、この静的値
            にフォールバックする (RELAY_SIGNALING_TOKEN と対で使うローカル
            検証用)。両方とも無ければその接続試行はスキップし、次回backoff
            で再試行する。

    config RELAY_SIGNALING_TOKEN
        string "Signaling Bearer token (拠点トークン、フォールバック用静的値)"
        default ""
        help
            device credential ('cred set <id> <secret>' で注入) が設定済み
            なら auth-worker (POST /device/cam-relay-token) から都度 mint
            した token を優先して使う (alc-gw-p4#2)。credential 未設定、
            または mint に失敗した場合のみ、この静的値 (キッティング時の
            埋め込み、旧 v1 方式) にフォールバックする。DO 側はまだこの
            ヘッダを検証しない (camera-relay-convention.md 参照)。

    config RELAY_AUTH_WORKER_URL
        string "auth-worker base URL (hub_link 相互認証・カメラ中継token mint用)"
        default "https://auth.ippoan.org"
        help
            POST /device/hub-token・POST /device/introspect
            (ippoan/auth-worker#406、ippoan/alc-app-s3#83 GW側実装) と
            POST /device/cam-relay-token (alc-gw-p4#2)・POST /device/token
            (alc-gw-p4#15、recorder_link用) 共通の宛先。staging で検証する
            場合は auth-staging.ippoan.org 等に変更する。

    config RECORDER_LINK_URL
        string "Recorder uplink WebSocket URL (cf-alc-recorder /ws)"
        default ""
        help
            wss://<recorder>/ws 形式。device JWT (RELAY_AUTH_WORKER_URL 経由で
            POST /device/token を mint) を Authorization: Bearer で付けて常時
            接続し、admin dashboard (auth-worker /device/setup) の「接続」
            「バージョン」列を role=device-gateway でも機能させる
            (alc-gw-p4#15)。空なら recorder_link 自体を起動しない
            (RELAY_SIGNALING_HOST と同じ規約)。

endmenu
```

## sdkconfig.defaults
```kconfig
# Espressif IoT Development Framework (ESP-IDF) 5.5.3
CONFIG_IDF_TARGET="esp32p4"

# 実機 (rev v1.3) 対応。ESP-IDF v5.5.3 の既定は v3.1+ のみ要求するため必須
# (examples/hello_world/sdkconfig.defaults, docs/hardware-notes.md 参照)
CONFIG_ESP32P4_SELECTS_REV_LESS_V3=y
CONFIG_ESP32P4_REV_MIN_1=y

# Unit PoE-P4: esp32p4 内蔵EMAC + IP101GRI PHY (RMII, 外部クロック GPIO50)。
# GPIO 値は m5stack/M5Unit-PoE-P4-UserDemo の実機 sdkconfig から採取
CONFIG_ETH_USE_ESP32_EMAC=y
CONFIG_ETH_PHY_INTERFACE_RMII=y
CONFIG_EXAMPLE_USE_INTERNAL_ETHERNET=y
CONFIG_EXAMPLE_ETH_PHY_IP101=y
CONFIG_EXAMPLE_ETH_MDC_GPIO=31
CONFIG_EXAMPLE_ETH_MDIO_GPIO=52
CONFIG_EXAMPLE_ETH_PHY_RST_GPIO=51
CONFIG_EXAMPLE_ETH_PHY_ADDR=1

# esp_peer (WebRTC) は DTLS-SRTP (RFC 5764) 鍵交換に mbedTLS の
# DTLS-SRTP サポートを要求するが、既定では無効 (どちらも default=n)。
# 有効化しないと components/espressif__esp_peer/src/dtls_srtp.c が
# mbedtls_ssl_conf_dtls_srtp_protection_profiles 等の未宣言エラーでビルド失敗する
CONFIG_MBEDTLS_SSL_PROTO_DTLS=y
CONFIG_MBEDTLS_SSL_DTLS_SRTP=y

# signaling_client (wss://) のサーバー証明書検証用。ESP-IDF v5.x は既定で
# y のはずだが明示しておく (ippoan/alc-app#129)
CONFIG_MBEDTLS_CERTIFICATE_BUNDLE=y

# hub_link (ippoan/alc-app-s3#83 GW側実装): CoreS3 が接続する WS:9000
# サーバーに esp_http_server の WebSocket サポートが要る (既定 n)
CONFIG_HTTPD_WS_SUPPORT=y

# 既定の partitions_singleapp.csv (factory 1MB 固定) は hub_link 追加後に
# 空き 0% まで逼迫したため、カスタムテーブル (partitions.csv) に切替。
# recorder_link 経由の OTA (alc-gw-p4#15 フェーズ3) 対応で otadata +
# ota_0/ota_1 の2スロット構成にした
CONFIG_PARTITION_TABLE_CUSTOM=y
CONFIG_PARTITION_TABLE_CUSTOM_FILENAME="partitions.csv"

# 実機は 16MB (Detected size(16384k)) だが、これまで2スロット化前の
# factory 単一スロット用に 2MB のまま設定していた。OTA 2スロット化に
# 伴い実サイズへ更新する
CONFIG_ESPTOOLPY_FLASHSIZE_16MB=y
CONFIG_ESPTOOLPY_FLASHSIZE="16MB"
CONFIG_ESPTOOLPY_HEADER_FLASHSIZE_UPDATE=y

# OTA ロールバック: 新イメージ起動後、recorder_link の初回認証付きWS接続
# 成功 (ota_link_confirm_running_app 呼び出し) まで pending 状態にし、
# それに失敗した場合は次回リセットで前スロットへ自動ロールバックさせる。
# secure boot は未設定のため anti-rollback (署名バージョン管理) は使わない
CONFIG_BOOTLOADER_APP_ROLLBACK_ENABLE=y

# この基板は PC と native USB Serial/JTAG (espflash/esptool が使うのと同じ
# COM ポート) でしか繋がっておらず、GPIO37/38 (既定の UART0 console) には
# 何も配線されていない。既定のまま (UART0 primary + USB を secondary で
# ログだけミラー) だと、console_cmds.c の対話コンソール (stdin) は誰も
# 繋いでいない UART0 の RX を待ち続け、USB 経由でどんなコマンドを送っても
# 一切応答が返らない事故になる (実機検証で特定、console_cmds.c 側も
# esp_console_new_repl_usb_serial_jtag に合わせて修正済み)。primary console
# 自体も USB Serial/JTAG に切り替え、UART0 との二重駆動を無くす。
CONFIG_ESP_CONSOLE_USB_SERIAL_JTAG=y
```
